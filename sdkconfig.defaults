## sdkconfig.defaults
```kconfig
CONFIG_ESPTOOLPY_FLASHSIZE_4MB=y
CONFIG_PARTITION_TABLE_CUSTOM=y
CONFIG_PARTITION_TABLE_CUSTOM_FILENAME="partitions.csv"
CONFIG_LWIP_IP_FORWARD=y
CONFIG_LWIP_IPV4_NAPT=y
CONFIG_LWIP_TCPIP_CORE_LOCKING=y
CONFIG_LWIP_TCPIP_TASK_STACK_SIZE=8192
CONFIG_LWIP_CHECK_THREAD_SAFETY=y
CONFIG_ESP_NETIF_BRIDGE_EN=y
CONFIG_ESP_NETIF_SET_DNS_PER_DEFAULT_NETIF=y
CONFIG_LWIP_IPV6=n
CONFIG_LWIP_IP4_FRAG=y
CONFIG_LWIP_IP4_REASSEMBLY=y
CONFIG_LWIP_SNTP_MAX_SERVERS=2
CONFIG_ETH_USE_ESP32_EMAC=y
CONFIG_ETH_RMII_CLK_INPUT=y
CONFIG_ETH_RMII_CLK_IN_GPIO=0
CONFIG_HTTPD_MAX_REQ_HDR_LEN=1024
CONFIG_ESP_MAIN_TASK_STACK_SIZE=8192
CONFIG_WIREGUARD_MAX_PEERS=1
CONFIG_WIREGUARD_MAX_SRC_IPS=1
CONFIG_COMPILER_OPTIMIZATION_PERF=y
```
